## ext/mincrypt/zephyr/Kconfig
```kconfig
# Copyright (c) 2022 Laczen
#
# SPDX-License-Identifier: Apache-2.0
#

mainmenu "MINCRYPT configuration"

menu "MINCRYPT settings"

config MINCRYPT
	bool "Enable MINCRYPT"

if MINCRYPT

module = MINCRYPT
module-str = mincrypt
source "subsys/logging/Kconfig.template.log_config"

endif # MINCRYPT

endmenu
```

## sFSL/zephyr/Kconfig
```kconfig
# Copyright (c) 2022 Laczen
#
# SPDX-License-Identifier: Apache-2.0
#

mainmenu "SBootKit configuration"

menu "SBootKit settings"

config SBK
	bool "Enable sBootKit"

config SBK_TINYCRYPT
        bool "Enable tinycrypt"

endmenu

source "Kconfig.zephyr"
```

## zephyr/Kconfig
```kconfig
# Copyright (c) 2022 Laczen
#
# SPDX-License-Identifier: Apache-2.0
#

mainmenu "SBootKit configuration"

menu "SBootKit settings"

config SBK
	bool "Enable sBootKit"

config SBK_MINCRYPT
        bool "Enable mincrypt"

config SBK_P256M
        bool "Enable p256-m"

config SBK_IMAGE_DEP
        bool "Enable Image Dependency check"
        default n

config SBK_PRODUCT_DEP
        bool "Enable Product Dependency check"
        default n

config SBK_IS_SFSL
        bool "Enable secure first stage loader options"
        default n

config SBK_IS_SLDR
        bool "Enable secure loader options"
        default n

if SBK

module = SBK
module-str = sbk
source "subsys/logging/Kconfig.template.log_config"

endif # SBK

endmenu
```
