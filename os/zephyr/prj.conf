## CMakeLists.txt
```
# SPDX-License-Identifier: Apache-2.0

cmake_minimum_required(VERSION 3.13.1)

# find_package(Zephyr) in order to load application boilerplate:
# http://docs.zephyrproject.org/application/application.html
find_package(Zephyr REQUIRED HINTS $ENV{ZEPHYR_BASE})

# Path to "os" subdirectory of repository root.
get_filename_component(OS_DIR ${APPLICATION_SOURCE_DIR} DIRECTORY)
# Path to repository root.
get_filename_component(ROOT_DIR ${OS_DIR} DIRECTORY)

file(READ "${ROOT_DIR}/VERSION" SBOOTKIT_VERSION)
project(sbkboot_${SBOOTKIT_VERSION})

# Path to sdkboot library
set(SBOOTKIT_DIR "${ROOT_DIR}/lib")
assert_exists(SBOOTKIT_DIR) 
# Path to tinycrypt library source subdirectory of root.
set(TINYCRYPT_DIR "${ROOT_DIR}/ext/tinycrypt/lib")
assert_exists(TINYCRYPT_DIR)

if(CONFIG_SBK)

zephyr_include_directories(
    ${ROOT_DIR}/lib/include
)
zephyr_library_sources(
    ${SBOOTKIT_DIR}/src/sbk_prep.c
    ${SBOOTKIT_DIR}/src/sbk_move.c
    ${SBOOTKIT_DIR}/src/sbk_crypto.c
    ${SBOOTKIT_DIR}/src/sbk_tlv.c
    ${SBOOTKIT_DIR}/src/sbk_os.c
)

zephyr_include_directories_ifdef(CONFIG_SBK_TINYCRYPT
    ${TINYCRYPT_DIR}/include
)
zephyr_library_sources_ifdef(CONFIG_SBK_TINYCRYPT
    ${TINYCRYPT_DIR}/source/utils.c
    ${TINYCRYPT_DIR}/source/sha256.c
    ${TINYCRYPT_DIR}/source/ecc.c
    ${TINYCRYPT_DIR}/source/ecc_dh.c
    ${TINYCRYPT_DIR}/source/ecc_dsa.c
    ${TINYCRYPT_DIR}/source/aes_encrypt.c
    ${TINYCRYPT_DIR}/source/aes_decrypt.c
)

zephyr_library_sources(
    ./src/main.c
)
endif()
```

## Kconfig
```
# Copyright (c) 2022 Laczen
#
# SPDX-License-Identifier: Apache-2.0
#

mainmenu "SBootKit configuration"

menu "SBootKit settings"

config SBK
	bool "Enable sBootKit"
	
config SBK_TINYCRYPT
        bool "Enable tinycrypt"

endmenu

source "Kconfig.zephyr"
```

## prj.conf
```kconfig
CONFIG_SBK=y
CONFIG_SBK_TINYCRYPT=y
```

## src/main.c
```c
/*
 * Copyright (c) 2021 Laczen
 *
 * SPDX-License-Identifier: Apache-2.0
 */

#include <stdarg.h>
#include "sbk/sbk_cfg.h"

int read(const struct sbk_cfg *cfg, const struct sbk_blk *blk, void *data, uint32_t len)
{
        return 0;
}

int prog(const struct sbk_cfg *cfg, const struct sbk_blk *blk, const void *data, uint32_t len)
{
        return 0;
}

int get_size(const struct sbk_cfg *cfg, const struct sbk_blk *blk, uint32_t *size)
{
        return 0;
}

uint32_t get_sector_size(const struct sbk_cfg *cfg)
{
        return 1024;
}

uint32_t get_image_count(const struct sbk_cfg *cfg)
{
        return 1;
}

void jump_image(const struct sbk_cfg *cfg)
{

}

        /* start execution of image in recovery slot (if available) */
void jump_recovery_image(const struct sbk_cfg *cfg)
{

}

SBK_REGISTER_CFG(NULL, read, prog, get_size, get_sector_size, get_image_count,
                 jump_image, jump_recovery_image);

void sbk_log(int level, const char *fmt, ...)
{
        va_list ap;
        va_start(ap, fmt);
        va_end(ap);
}

void (*sbk_log_fp)(int level, const char *fmt, ...) = NULL;

void main(void)
{

}
```
