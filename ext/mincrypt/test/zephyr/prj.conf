## CMakeLists.txt
```
# SPDX-License-Identifier: Apache-2.0

cmake_minimum_required(VERSION 3.13.1)

# find_package(Zephyr) in order to load application boilerplate:
# http://docs.zephyrproject.org/application/application.html
find_package(Zephyr REQUIRED HINTS $ENV{ZEPHYR_BASE})

project(testMINCRYPT)

# Path to mincrypt test directory.
get_filename_component(MINCRYPT_TEST_DIR ${CMAKE_CURRENT_LIST_DIR} DIRECTORY)
assert_exists(MINCRYPT_TEST_DIR)

# Path to mincrypt directory.
get_filename_component(MINCRYPT_DIR ${MINCRYPT_TEST_DIR} DIRECTORY)
assert_exists(MINCRYPT_DIR)

zephyr_include_directories(
    ${MINCRYPT_DIR}/include
    ${MINCRYPT_TEST_DIR}/include
)

zephyr_library_sources(
    ${MINCRYPT_DIR}/src/crypto_sha256.c
    ${MINCRYPT_DIR}/src/crypto_chacha20poly1305.c
    ${MINCRYPT_TEST_DIR}/src/crypto_sha256_tvectors.c
    ${MINCRYPT_TEST_DIR}/src/crypto_chacha20poly1305_tvectors.c
)

FILE(GLOB app_sources src/*.c)

target_sources(app PRIVATE ${app_sources})
```

## prj.conf
```kconfig
CONFIG_MAIN_STACK_SIZE=4096
CONFIG_STACK_USAGE=y
CONFIG_SIZE_OPTIMIZATIONS=y
#CONFIG_SPEED_OPTIMIZATIONS=y
```

## src/main.c
```c
/*
 * Copyright (c) 2022 Laczen
 *
 * SPDX-License-Identifier: Apache-2.0
 */
#include <stdint.h>
#include <zephyr/sys/printk.h>
#include <zephyr/kernel.h>
#include "mincrypt_test/crypto_sha256_tvectors.h"
#include "mincrypt_test/crypto_chacha20poly1305_tvectors.h"

void tst_crypto_sha256(void)
{
        size_t cnt = crypto_sha256_testcnt();
        for (size_t i = 0; i < cnt; ++i) {
                if (crypto_sha256_test(i) != 0) {
                        printk("sha256 test %d failed\n", i + 1);
                        return;
                }
        }

        printk("sha256 passed %d tests\n", cnt);
}

void tst_crypto_hmac_sha256(void)
{
        size_t cnt = crypto_hmac_sha256_testcnt();
        for (size_t i = 0; i < cnt; ++i) {
                if (crypto_hmac_sha256_test(i) != 0) {
                        printk("hmac_sha256 test %d failed\n", i + 1);
                        return;
                }
        }

        printk("hmac_sha256 passed %d tests\n", cnt);
}

void tst_crypto_hkdf_sha256(void)
{
        size_t cnt = crypto_hkdf_sha256_testcnt();
        for (size_t i = 0; i < cnt; ++i) {
                if (crypto_hkdf_sha256_test(i) != 0) {
                        printk("hkdf_sha256 test %d failed\n", i + 1);
                        return;
                }
        }

        printk("hkdf_sha256 passed %d tests\n", cnt);
}

void tst_crypto_poly1305(void)
{
        size_t cnt = crypto_poly1305_testcnt();
        for (size_t i = 0; i < cnt; ++i) {
                if (crypto_poly1305_test(i) != 0) {
                        printk("poly1305 test %d failed\n", i + 1);
                        return;
                }
        }

        printk("poly1305 passed %d tests\n", cnt);
}

void tst_crypto_chacha20(void)
{
        size_t cnt = crypto_chacha20_testcnt();
        for (size_t i = 0; i < cnt; ++i) {
                if (crypto_chacha20_test(i) != 0) {
                        printk("chacha20 test %d failed\n", i + 1);
                        return;
                }
        }

        printk("chacha20 passed %d tests\n", cnt);
}

void main(void)
{
        tst_crypto_sha256();
        tst_crypto_hmac_sha256();
        tst_crypto_hkdf_sha256();
        tst_crypto_poly1305();
        tst_crypto_chacha20();
        printk("Done\n");
}
```
