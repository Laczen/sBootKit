## CMakeLists.txt
```
# SPDX-License-Identifier: Apache-2.0

cmake_minimum_required(VERSION 3.13.1)

# find_package(Zephyr) in order to load application boilerplate:
# http://docs.zephyrproject.org/application/application.html
find_package(Zephyr REQUIRED HINTS $ENV{ZEPHYR_BASE})

project(sBootKit_test)

FILE(GLOB app_sources src/*.c)

target_sources(app PRIVATE ${app_sources})
```

## Kconfig
```
# Copyright (c) 2022 Laczen
#
# SPDX-License-Identifier: Apache-2.0
#

mainmenu "SBootKit configuration"

menu "SBootKit settings"

config SBK
	bool "Enable sBootKit"
	
config SBK_TINYCRYPT
        bool "Enable tinycrypt"

config SBK_TLV_MANIFEST
        bool "Enable support for TLV manifest"

endmenu

source "Kconfig.zephyr"
```

## prj.conf
```kconfig
CONFIG_SBK=y
CONFIG_SBK_TINYCRYPT=y
CONFIG_LOG=y
CONFIG_LOG_MODE_MINIMAL=y
CONFIG_SBK_LOG_LEVEL_DBG=y

CONFIG_ZTEST=y
CONFIG_ZTEST_NEW_API=y
CONFIG_ZTEST_STACK_SIZE=4096
```

## src/main.c
```c
/*
 * Copyright (c) 2021 Laczen
 *
 * SPDX-License-Identifier: Apache-2.0
 */

#include <stdarg.h>
#include <zephyr/kernel.h>
#include <zephyr/ztest.h>
#include <zephyr/sys/printk.h>
#include "sbk/sbk_os.h"

uint8_t buffer[2048];

static int read(const void *ctx, uint32_t off, void *data, uint32_t len)
{
        memcpy(data, (void *)&buffer[off], len);
        return 0;
}

static int prog(const void *ctx, uint32_t off, const void *data, uint32_t len)
{
        memcpy(&buffer[off], (uint8_t *)data, len);
        return 0;
}

static int sync(const void *ctx)
{
        /* flush remaining data to backend */

        /* free stores entry */
        return 0;
}

static uint32_t get_size(const void *ctx)
{
        return (uint32_t)sizeof(buffer);
}

static uint32_t get_start_address(const void *ctx)
{
        return 0U;
}

static int slot_init(struct sbk_os_slot *slot, uint32_t slot_no)
{
        slot->ctx = NULL;
        slot->read = read;
        slot->prog = prog;
        slot->sync = sync;
        slot->get_size = get_size;
        slot->get_start_address = get_start_address;
        return 0;
}

uint32_t get_slot_cnt(void)
{
        return 1U;
}

int (*sbk_os_slot_init)(struct sbk_os_slot *slot, uint32_t slot_no) = slot_init;
```

## src/test_sbk_crypto.c
```c
/*
 * Copyright (c) 2019 Laczen
 * Copyright (c) 2017 Nordic Semiconductor ASA
 * Copyright (c) 2015 Runtime Inc
 *
 * SPDX-License-Identifier: Apache-2.0
 */

#include <zephyr/ztest.h>
#include "sbk/sbk_crypto.h"

struct digest_rd_ctx {
        uint8_t *buffer;
        uint32_t buffer_size;
};

int digest_read(const void *ctx, uint32_t offset, void *data, uint32_t len)
{
        struct digest_rd_ctx *rd_ctx = (struct digest_rd_ctx *)ctx;

        if ((offset + len) > rd_ctx->buffer_size) {
                return -1;
        }

        memcpy(data, rd_ctx->buffer + offset, len);
        return 0;
}

ZTEST_SUITE(sbk_crypto_tests, NULL, NULL, NULL, NULL, NULL);

extern uint8_t test_msg[];
extern uint8_t test_msg_bytes;
extern uint8_t test_msg_digest[];
extern uint8_t test_msg_digest_bytes;

/**
 * @brief Test digest calculation
 */
ZTEST(sbk_crypto_tests, sbk_digest)
{
        int err;
        struct digest_rd_ctx ctx = {
                .buffer = test_msg,
                .buffer_size = SBK_CRYPTO_FW_HASH_SIZE,
        };
	struct sbk_crypto_se digest_se = {
		.data = test_msg_digest,
	};

	err = sbk_crypto_digest_verify(&digest_se, &digest_read, (void *)&ctx,
                		       test_msg_bytes);
	zassert_true(err == 0, "Digest differs");
}

extern uint8_t test_signature[];
extern uint8_t ec256_root_pub_key[];

/**
 * @brief Test signature verification
 */
ZTEST(sbk_crypto_tests, sbk_sign_verify)
{
	int err;
	uint8_t seal[SBK_CRYPTO_FW_SEAL_SIZE];
	uint8_t *slptr = &seal[0];
	struct sbk_crypto_se seal_se = {
		.data = slptr,
	};
	struct digest_rd_ctx ctx = {
                .buffer = test_msg,
                .buffer_size = SBK_CRYPTO_FW_HASH_SIZE,
        };

	memcpy(slptr, &ec256_root_pub_key[0], SBK_CRYPTO_FW_SEAL_PUBKEY_SIZE);
	slptr += SBK_CRYPTO_FW_SEAL_PUBKEY_SIZE;
	memcpy(slptr, &test_signature[0], SBK_CRYPTO_FW_SEAL_SIGNATURE_SIZE);

	err = sbk_crypto_seal_verify(&seal_se, &digest_read, (void *)&ctx,
                		     test_msg_bytes);
	zassert_true(err == 0, "Signature validation failed: [err %d]", err);

	uint8_t tmp = test_msg[0];

	test_msg[0] += 1;
	err = sbk_crypto_seal_verify(&seal_se, &digest_read, (void *)&ctx,
                		     test_msg_bytes);
	zassert_false(err == 0, "Signature validation error: [err %d]", err);

	test_msg[0] = tmp;
}

extern uint8_t test_enc_pubkey[];
extern uint8_t test_enc_key[];
extern uint8_t ec256_boot_pri_key[];

/**
 * @brief Test the generation of an encryption key from public key
 */
ZTEST(sbk_crypto_tests, sbk_gen_encr_param)
{
	int err;
	uint8_t param[32], tmp;
	struct sbk_crypto_se out_se = {
		.data = &param[0],
	};
	const struct sbk_crypto_se pubk_se = {
		.data = &test_enc_pubkey[0],
	};
	const struct sbk_crypto_se priv_se = {
		.data = &ec256_boot_pri_key[0],
	};

	err = sbk_crypto_get_encr_param(&out_se, &pubk_se, &priv_se);
	zassert_true(err == 0,  "Failed to get encryption key: [err %d]", err);
	err = memcmp(param, test_enc_key, 16);
	zassert_true(err == 0,  "Encryption keys differ: [err %d]", err);

	/* modify the key */
	tmp = test_enc_pubkey[0];
	test_enc_pubkey[0] >>= 1;
	err = sbk_crypto_get_encr_param(&out_se, &pubk_se, &priv_se);
	zassert_false(err == 0,  "Invalid pubkey generates encryption key");

	/* reset the key */
	test_enc_pubkey[0] = tmp;
}

extern uint8_t test_msg[];
extern uint8_t test_msg_bytes;
extern uint8_t ec256_boot_pri_key[];

/**
 * @brief Test the aes routines
 */
ZTEST(sbk_crypto_tests, sbk_aes)
{
	uint8_t enc_test_msg[test_msg_bytes];
	uint8_t dec_test_msg[test_msg_bytes];
	uint8_t param[SBK_CRYPTO_FW_AESCTR_PAR_SIZE];
	uint8_t *paramptr = &param[0];
	struct sbk_crypto_se param_se = {
		.data = paramptr,
	};
	uint8_t aes_bc = test_msg_bytes/SBK_CRYPTO_FW_AESCTR_BLOCK_SIZE;
	int err;

	memcpy(paramptr, &ec256_boot_pri_key[0], SBK_CRYPTO_FW_AESCTR_KEY_SIZE);
	paramptr += SBK_CRYPTO_FW_AESCTR_KEY_SIZE;
	memset(paramptr, 0, SBK_CRYPTO_FW_AESCTR_CTR_SIZE);

	memcpy(enc_test_msg, test_msg, test_msg_bytes);
	err = sbk_crypto_aes_ctr_mode(enc_test_msg, test_msg_bytes, &param_se);
	zassert_true(err == 0,  "AES CTR returned [err %d]", err);
	err = param[SBK_CRYPTO_FW_AESCTR_PAR_SIZE - 1] - aes_bc;
	zassert_true(err == 0,  "AES CTR wrong CTR value");
	err = memcmp(enc_test_msg, test_msg, test_msg_bytes);
	zassert_false(err == 0,  "AES wrong encrypt data");

	memset(paramptr, 0, SBK_CRYPTO_FW_AESCTR_CTR_SIZE);
	memcpy(dec_test_msg, enc_test_msg, test_msg_bytes);
	err = sbk_crypto_aes_ctr_mode(dec_test_msg, test_msg_bytes, &param_se);
	zassert_true(err == 0,  "AES CTR returned [err %d]", err);
	err = param[SBK_CRYPTO_FW_AESCTR_PAR_SIZE - 1] - aes_bc;
	zassert_true(err == 0,  "AES CTR wrong CTR value");
	err = memcmp(dec_test_msg, test_msg, test_msg_bytes);
	zassert_true(err == 0,  "AES wrong decrypt data");
}
```

## src/test_sbk_image.c
```c
/*
 * Copyright (c) 2019 Laczen
 * Copyright (c) 2017 Nordic Semiconductor ASA
 * Copyright (c) 2015 Runtime Inc
 *
 * SPDX-License-Identifier: Apache-2.0
 */

#include <zephyr/ztest.h>

#include "sbk/sbk_product.h"
#include "sbk/sbk_image.h"
#include "sbk/sbk_os.h"

#include "testimage0.h"

uint32_t product_hash = 0xAABBCCDD;
struct sbk_version product_version = {
        .major = 0,
        .minor = 0,
        .revision = 0,
};

struct {
        struct sbk_image_meta_start image_meta_start;
        struct sbk_image_dep_info image_dep_info;
        struct sbk_product_dep_info product_dep_info;
        struct sbk_image_state image_state;
} image = {
        .image_meta_start = {
                .rec_hdr = {
                        .tag = 0x8000,
                        .len = sizeof(struct sbk_image_meta_start),
                },
                .image_dep_tag = 0x0001,
                .product_dep_tag = 0x0002,
                .image_state_tag = 0x8003,
                .next_tag = 0x7FFF,
        },
        .image_dep_info = {
                .rec_hdr = {
                        .tag = 0x0001,
                        .len = sizeof(struct sbk_image_dep_info),
                },
        },
        .product_dep_info = {
                .rec_hdr = {
                        .tag = 0x0002,
                        .len = sizeof(struct sbk_product_dep_info),
                },
                .product_hash = 0xAABBCCDD,
        },
        .image_state = {
                .rec_hdr = {
                        .tag = 0x8003,
                        .len = sizeof(struct sbk_image_state),
                },
        },
};

ZTEST_SUITE(sbk_image_tests, NULL, NULL, NULL, NULL, NULL);

/**
 * @brief
 */
ZTEST(sbk_image_tests, sbk_image_get_tag)
{
        struct sbk_os_slot slot;
        struct sbk_image_meta_start start;
        struct sbk_image_dep_info img_dep_info;
        struct sbk_product_dep_info prd_dep_info;
        struct sbk_image_state img_state;
        int err;

        sbk_product_init_hash(&product_hash);
        sbk_product_init_version(&product_version);

        err = sbk_os_slot_open(&slot, 0);
        zassert_true(err == 0, "Failed slot open: [err %d]", err);

        err = sbk_os_slot_prog(&slot, 0U, &image, sizeof(image));
        zassert_true(err == 0, "Failed slot program: [err %d]", err);

        err = sbk_image_get_tag_data(&slot, 0x8000, &start, sizeof(start));
        zassert_true(err == 0, "Failed getting start tag: [err %d]", err);
        err = memcmp(&start, &image.image_meta_start, sizeof(start));
        zassert_true(err == 0, "Start tag contaings wrong value");

        err = sbk_image_get_tag_data(&slot, 0x0001, &img_dep_info,
                                     sizeof(img_dep_info));
        zassert_true(err == 0, "Failed getting image_dep_info: [err %d]", err);
        err = memcmp(&img_dep_info, &image.image_dep_info,
                     sizeof(img_dep_info));
        zassert_true(err == 0, "Image dep info tag contaings wrong value");

        err = sbk_image_get_tag_data(&slot, 0x0002, &prd_dep_info,
                                     sizeof(prd_dep_info));
        zassert_true(err == 0, "Failed getting product_dep_info: [err %d]", err);
        err = memcmp(&prd_dep_info, &image.product_dep_info,
                     sizeof(prd_dep_info));
        zassert_true(err == 0, "Product dep info tag contaings wrong value");

        err = sbk_image_get_tag_data(&slot, 0x8003, &img_state,
                                     sizeof(img_state));
        zassert_true(err == 0, "Failed getting image_state: [err %d]", err);
        err = memcmp(&img_state, &image.image_state, sizeof(img_state));
        zassert_true(err == 0, "Image state tag contaings wrong value");

        err = sbk_image_get_tag_data(&slot, 0x0003, &img_state,
                                     sizeof(img_state));
        zassert_false(err == 0, "Succeeded to get bad tag");

        err = sbk_os_slot_close(&slot);
        zassert_true(err == 0, "Failed slot close: [err %d]", err);
}

/*
 * @brief
 */
ZTEST(sbk_image_tests, sbk_product_dependency)
{
        struct sbk_os_slot slot;
        int err;

        sbk_product_init_hash(&product_hash);
        sbk_product_init_version(&product_version);

        err = sbk_os_slot_open(&slot, 0);
        zassert_true(err == 0, "Failed slot open: [err %d]", err);

        err = sbk_os_slot_prog(&slot, 0U, &image, sizeof(image));
        zassert_true(err == 0, "Failed slot program: [err %d]", err);

        err = sbk_image_product_verify(&slot);
        zassert_true(err == 0, "Failed board verify: [err %d]", err);

        /* set a unsupported board id */
        image.product_dep_info.product_hash = product_hash + 1U;

        err = sbk_os_slot_prog(&slot, 0U, &image, sizeof(image));
        zassert_true(err == 0, "Failed slot program: [err %d]", err);

        err = sbk_image_product_verify(&slot);
        zassert_false(err == 0, "Verify succeeded on bad board: [err %d]", err);

        /* reset the board id */
        image.product_dep_info.product_hash = product_hash;

        /* set a unsupported board range*/
        image.product_dep_info.vrange.min_version.major = 1U;
        image.product_dep_info.vrange.max_version.major = 1U;

        err = sbk_os_slot_prog(&slot, 0U, &image, sizeof(image));
        zassert_true(err == 0, "Failed slot program: [err %d]", err);

        err = sbk_image_product_verify(&slot);
        zassert_false(err == 0, "Verify succeeded on bad board version");

        /* reset the supported board range*/
        image.product_dep_info.vrange.min_version.major = 0U;
        image.product_dep_info.vrange.max_version.major = 0U;

        err = sbk_os_slot_close(&slot);
        zassert_true(err == 0, "Failed slot close: [err %d]", err);
}

/*
 * @brief
 */
ZTEST(sbk_image_tests, sbk_signed_image)
{
        struct sbk_os_slot slot;
        int err;

        sbk_product_init_hash(&product_hash);
        sbk_product_init_version(&product_version);

        err = sbk_os_slot_open(&slot, 0);
        zassert_true(err == 0, "Failed slot open: [err %d]", err);

        err = sbk_os_slot_prog(&slot, 0U, &image_0, sizeof(image_0));
        zassert_true(err == 0, "Failed slot program: [err %d]", err);

        err = sbk_image_product_verify(&slot);
        zassert_true(err == 0, "Failed board verify: [err %d]", err);

        err = sbk_image_seal_verify(&slot);
        zassert_true(err == 0, "Failed seal verify: [err %d]", err);

        err = sbk_os_slot_close(&slot);
        zassert_true(err == 0, "Failed slot close: [err %d]", err);
}

/*
 * @brief
 */
ZTEST(sbk_image_tests, sbk_bootable_image)
{
        struct sbk_os_slot slot;
        uint32_t address;
        int err;

        sbk_product_init_hash(&product_hash);
        sbk_product_init_version(&product_version);

        err = sbk_os_slot_open(&slot, 0);
        zassert_true(err == 0, "Failed slot open: [err %d]", err);

        err = sbk_os_slot_prog(&slot, 0U, &image_0, sizeof(image_0));
        zassert_true(err == 0, "Failed slot program: [err %d]", err);

        err = sbk_os_slot_close(&slot);
        zassert_true(err == 0, "Failed slot close: [err %d]", err);

        err = sbk_image_bootable(0, &address);
        zassert_true(err == 0, "Failed bootable image check: [err %d]", err);
}
```

## src/test_sbk_os.c
```c
/*
 * Copyright (c) 2022 Laczen
 * SPDX-License-Identifier: Apache-2.0
 */

#include <zephyr/ztest.h>
#include <zephyr/sys/printk.h>
#include "sbk/sbk_os.h"

ZTEST_SUITE(sbk_os_tests, NULL, NULL, NULL, NULL, NULL);

/**
 * @brief Test working with slot
 */
ZTEST(sbk_os_tests, os_slot)
{
        int err;
        struct sbk_os_slot slot;
        uint8_t test_data[]="Just a test string";
        uint8_t rd_data[sizeof(test_data)];

        err = sbk_os_slot_open(&slot, 0);
        zassert_true(err == 0, "Failed slot open: [err %d]", err);

        zassert_true(slot.read != NULL, "slot read config error");
        zassert_true(slot.prog != NULL, "slot prog config error");
        zassert_true(slot.sync != NULL, "slot sync config error");

        err = sbk_os_slot_prog(&slot, 0, test_data, sizeof(test_data));
        zassert_true(err == 0, "Failed slot prog: [err %d]", err);

        err = sbk_os_slot_read(&slot, 0, rd_data, sizeof(test_data));
        zassert_true(err == 0, "Failed slot read: [err %d]", err);

        err = memcmp(test_data, rd_data, sizeof(test_data));
        zassert_true(err == 0, "Failed data compare");

        err = sbk_os_slot_close(&slot);
        zassert_true(err == 0, "Failed slot close: [err %d]", err);
}
```

## src/test_sbk_tlv.c
```c
/*
 * Copyright (c) 2021 Laczen
 *
 * SPDX-License-Identifier: Apache-2.0
 */

#include <ztest.h>
#include "sbk/sbk_tlv.h"

uint8_t test_haystack[] = {
        1,0,2,0, 1,2, 	/* type = 1, length = 2, value = 1 2 */
        2,0,3,0, 3,4,5, /* type = 2, length = 3, value = 3 4 5 */
        3,0,1,0, 6,	/* type = 3, length = 1, value = 6 */
        4,0,26,0,       /* type = 4, length = 26, set of tlv's */
                1,0,2,0, 1,2, 	/* type = 1, length = 2, value = 1 2 */
                2,0,3,0, 3,4,5, /* type = 2, length = 3, value = 3 4 5 */
                3,0,1,0, 6,	/* type = 3, length = 1, value = 6 */
                0,1,2,0, 7,8,	/* type = 0x10, length = 1, value = 7 8 */
                0,0,		/* end the tlv area with a type zero */ 
        0,1,2,0, 7,8,	/* type = 0x10, length = 2, value = 7 8 */
        0,0		/* end the tlv area with a type zero */
};

struct tlv_rd_ctx {
        uint8_t *buffer;
        uint32_t buffer_size;
};

int tlv_read(const void *ctx, uint32_t offset, void *data, uint32_t len)
{
        struct tlv_rd_ctx *rd_ctx = (struct tlv_rd_ctx *)ctx;

        if ((offset + len) > rd_ctx->buffer_size) {
                return -1;
        }

        memcpy(data, rd_ctx->buffer + offset, len);
        return 0;
}

void test_tlv(void)
{
        int err;
        struct tlv_rd_ctx rd_ctx = {
                .buffer = test_haystack,
                .buffer_size = sizeof(test_haystack)
        };
        struct tlv_rd_ctx rd_ctx_sub;
        struct sbk_tlv_entry entry, sub_entry;
        uint8_t buf[sizeof(test_haystack)];

        /* Program the haystack */
        
        sbk_tlv_walk_init(&entry);
        while ((sbk_tlv_walk(&entry, &tlv_read, (void *)&rd_ctx) == 0) && 
               (entry.hdr.tag != 0x01)) {
        }
        
        memset(buf, 0xff, sizeof(buf));
        zassert_true(entry.hdr.tag == 1, "Entry type 1 not found");
        zassert_true(entry.hdr.len == 2, "Entry type 1 wrong length");
        tlv_read((void *)&rd_ctx, entry.offset, buf, entry.hdr.len);
        err = memcmp(&test_haystack[4], buf, entry.hdr.len);
        zassert_true(err == 0, "Entry type 1 wrong value %d");

        sbk_tlv_walk_init(&entry);
        while ((sbk_tlv_walk(&entry, &tlv_read, (void *)&rd_ctx) == 0) && 
               (entry.hdr.tag != 0x02)) {
        }
        
        memset(buf, 0xff, sizeof(buf));
        zassert_true(entry.hdr.tag == 2, "Entry type 2 not found");
        zassert_true(entry.hdr.len == 3, "Entry type 2 wrong length");
        tlv_read((void *)&rd_ctx, entry.offset, buf, entry.hdr.len);
        err = memcmp(&test_haystack[10], buf, entry.hdr.len);
        zassert_true(err == 0, "Entry type 2 wrong value %d");

        sbk_tlv_walk_init(&entry);
        while ((sbk_tlv_walk(&entry, &tlv_read, (void *)&rd_ctx) == 0) && 
               (entry.hdr.tag != 0x03)) {
        }
        
        memset(buf, 0xff, sizeof(buf));
        zassert_true(entry.hdr.tag == 3, "Entry type 3 not found");
        zassert_true(entry.hdr.len == 1, "Entry type 3 wrong length");
        tlv_read((void *)&rd_ctx, entry.offset, buf, entry.hdr.len);
        err = memcmp(&test_haystack[17], buf, entry.hdr.len);
        zassert_true(err == 0, "Entry type 3 wrong value %d");

        sbk_tlv_walk_init(&entry);
        while ((sbk_tlv_walk(&entry, &tlv_read, (void *)&rd_ctx) == 0) && 
               (entry.hdr.tag != 256)) {
        }
        
        memset(buf, 0xff, sizeof(buf));
        zassert_true(entry.hdr.tag == 256, "Entry type 256 not found");
        zassert_true(entry.hdr.len == 2, "Entry type 256 wrong length");
        tlv_read((void *)&rd_ctx, entry.offset, buf, entry.hdr.len);
        err = memcmp(&test_haystack[52], buf, entry.hdr.len);
        zassert_true(err == 0, "Entry type 256 wrong value %d");

        sbk_tlv_walk_init(&entry);
        while ((sbk_tlv_walk(&entry, &tlv_read, (void *)&rd_ctx) == 0) && 
               (entry.hdr.tag != 0x05)) {
        }
        zassert_false(entry.hdr.tag == 5, "Found non existing entry type 5");

        sbk_tlv_walk_init(&entry);
        while ((sbk_tlv_walk(&entry, &tlv_read, (void *)&rd_ctx) == 0) && 
               (entry.hdr.tag != 0x04)) {
        }
        zassert_true(entry.hdr.tag == 4, "Entry type 4 not found");
        zassert_true(entry.hdr.len == 26, "Entry type 4 wrong length");

        rd_ctx_sub.buffer = &test_haystack[entry.offset];
        rd_ctx_sub.buffer_size = sizeof(test_haystack) - entry.offset;
        sbk_tlv_walk_init(&sub_entry);
        while ((sbk_tlv_walk(&sub_entry, &tlv_read, (void *)&rd_ctx_sub) == 0) && 
               (sub_entry.hdr.tag != 0x03)) {
        }
        zassert_true(sub_entry.hdr.tag == 3, "Sub entry type 3 not found");
        zassert_true(sub_entry.hdr.len == 1, "Sub entry type 3 wrong length");

}

void test_sbk_tlv(void)
{
        ztest_test_suite(test_sbk_tlv,
	        ztest_unit_test(test_tlv)
        );

	ztest_run_test_suite(test_sbk_tlv);
}
```

## src/testimage0.h
```c
const unsigned char image_0[1024] = {
	0x00, 0x80, 0x10, 0x00, 0x00, 0x00, 0x01, 0x00,
	0x01, 0x00, 0x00, 0x00, 0x02, 0x00, 0xff, 0x7f,
	0x01, 0x00, 0x10, 0x00, 0x00, 0x00, 0x00, 0x00,
	0x00, 0x00, 0x01, 0x00, 0x00, 0x00, 0x00, 0x00,
	0x02, 0x00, 0x14, 0x00, 0x00, 0x00, 0x00, 0x02,
	0x00, 0x02, 0x00, 0x00, 0x80, 0x00, 0x03, 0x80,
	0x00, 0x00, 0x00, 0x00, 0x03, 0x80, 0x28, 0x00,
	0x80, 0x00, 0x00, 0x00, 0x07, 0x6a, 0x27, 0xc7,
	0x9e, 0x5a, 0xce, 0x2a, 0x3d, 0x47, 0xf9, 0xdd,
	0x2e, 0x83, 0xe4, 0xff, 0x6e, 0xa8, 0x87, 0x2b,
	0x3c, 0x22, 0x18, 0xf6, 0x6c, 0x92, 0xb8, 0x9b,
	0x55, 0xf3, 0x65, 0x60, 0xff, 0x7f, 0x88, 0x00,
	0x80, 0x00, 0x00, 0x00, 0x2e, 0x8d, 0xef, 0xb8,
	0x12, 0xf7, 0x2d, 0x71, 0x2f, 0xdf, 0xc5, 0xa5,
	0x2c, 0x08, 0x5d, 0xc8, 0xd5, 0x7d, 0x8f, 0x5b,
	0xa9, 0xa4, 0x93, 0xf3, 0xe7, 0x9e, 0x37, 0x98,
	0xef, 0xf8, 0xbd, 0x41, 0x37, 0x94, 0x32, 0x79,
	0xea, 0x3b, 0xdc, 0xd4, 0x9a, 0xc9, 0xb0, 0x98,
	0x06, 0x33, 0xee, 0x83, 0xfd, 0x24, 0x81, 0xfe,
	0x09, 0xfa, 0xd3, 0xde, 0xda, 0xc0, 0x13, 0xd0,
	0xad, 0x2b, 0x15, 0x1d, 0xf3, 0xc8, 0xed, 0x99,
	0x9d, 0xb3, 0x5b, 0x8c, 0xd3, 0x64, 0x24, 0x4b,
	0x1c, 0x83, 0x8f, 0xb1, 0xcc, 0x1b, 0x65, 0x0c,
	0x8c, 0x7c, 0xfc, 0x0f, 0x5d, 0x0c, 0x30, 0x31,
	0xbc, 0x9b, 0xd3, 0xcb, 0xf0, 0x5f, 0x9b, 0x31,
	0x69, 0x7f, 0x2c, 0x95, 0x4b, 0x54, 0xf0, 0x4b,
	0xf6, 0xcc, 0xa2, 0xa9, 0x9b, 0xb6, 0xc0, 0x32,
	0x54, 0xa0, 0x85, 0x79, 0x3e, 0x03, 0x6a, 0x59,
	0x26, 0x87, 0xcd, 0x37, 0x99, 0x84, 0x58, 0x7d,
	0x47, 0xa6, 0xfa, 0x90, 0x60, 0xf9, 0x89, 0x07,
	0xf2, 0x03, 0xd0, 0xdc, 0x48, 0x14, 0x7f, 0x93,
	0xb1, 0xb0, 0xfb, 0x7c, 0x9f, 0x2c, 0x38, 0x29,
	0x1e, 0x1c, 0x58, 0x6f, 0x00, 0x00, 0x00, 0x00,
	0x00, 0x00, 0x00, 0x00, 0x00, 0x00, 0x00, 0x00,
	0x00, 0x00, 0x00, 0x00, 0x00, 0x00, 0x00, 0x00,
	0x00, 0x00, 0x00, 0x00, 0x00, 0x00, 0x00, 0x00,
	0x00, 0x00, 0x00, 0x00, 0x00, 0x00, 0x00, 0x00,
	0x00, 0x00, 0x00, 0x00, 0x00, 0x00, 0x00, 0x00,
	0x00, 0x00, 0x00, 0x00, 0x00, 0x00, 0x00, 0x00,
	0x00, 0x00, 0x00, 0x00, 0x00, 0x00, 0x00, 0x00,
	0x00, 0x00, 0x00, 0x00, 0x00, 0x00, 0x00, 0x00,
	0x00, 0x00, 0x00, 0x00, 0x00, 0x00, 0x00, 0x00,
	0x00, 0x00, 0x00, 0x00, 0x00, 0x00, 0x00, 0x00,
	0x00, 0x00, 0x00, 0x00, 0x00, 0x00, 0x00, 0x00,
	0x00, 0x00, 0x00, 0x00, 0x00, 0x00, 0x00, 0x00,
	0x00, 0x00, 0x00, 0x00, 0x00, 0x00, 0x00, 0x00,
	0x00, 0x00, 0x00, 0x00, 0x00, 0x00, 0x00, 0x00,
	0x00, 0x00, 0x00, 0x00, 0x00, 0x00, 0x00, 0x00,
	0x00, 0x00, 0x00, 0x00, 0x00, 0x00, 0x00, 0x00,
	0x00, 0x00, 0x00, 0x00, 0x00, 0x00, 0x00, 0x00,
	0x00, 0x00, 0x00, 0x00, 0x00, 0x00, 0x00, 0x00,
	0x00, 0x00, 0x00, 0x00, 0x00, 0x00, 0x00, 0x00,
	0x00, 0x00, 0x00, 0x00, 0x00, 0x00, 0x00, 0x00,
	0x00, 0x00, 0x00, 0x00, 0x00, 0x00, 0x00, 0x00,
	0x00, 0x00, 0x00, 0x00, 0x00, 0x00, 0x00, 0x00,
	0x00, 0x00, 0x00, 0x00, 0x00, 0x00, 0x00, 0x00,
	0x00, 0x00, 0x00, 0x00, 0x00, 0x00, 0x00, 0x00,
	0x00, 0x00, 0x00, 0x00, 0x00, 0x00, 0x00, 0x00,
	0x00, 0x00, 0x00, 0x00, 0x00, 0x00, 0x00, 0x00,
	0x00, 0x00, 0x00, 0x00, 0x00, 0x00, 0x00, 0x00,
	0x00, 0x00, 0x00, 0x00, 0x00, 0x00, 0x00, 0x00,
	0x00, 0x00, 0x00, 0x00, 0x00, 0x00, 0x00, 0x00,
	0x00, 0x00, 0x00, 0x00, 0x00, 0x00, 0x00, 0x00,
	0x00, 0x00, 0x00, 0x00, 0x00, 0x00, 0x00, 0x00,
	0x00, 0x00, 0x00, 0x00, 0x00, 0x00, 0x00, 0x00,
	0x00, 0x00, 0x00, 0x00, 0x00, 0x00, 0x00, 0x00,
	0x00, 0x00, 0x00, 0x00, 0x00, 0x00, 0x00, 0x00,
	0x00, 0x00, 0x00, 0x00, 0x00, 0x00, 0x00, 0x00,
	0x00, 0x00, 0x00, 0x00, 0x00, 0x00, 0x00, 0x00,
	0x00, 0x00, 0x00, 0x00, 0x00, 0x00, 0x00, 0x00,
	0x00, 0x00, 0x00, 0x00, 0x00, 0x00, 0x00, 0x00,
	0x00, 0x00, 0x00, 0x00, 0x00, 0x00, 0x00, 0x00,
	0x00, 0x00, 0x00, 0x00, 0x00, 0x00, 0x00, 0x00,
	0x00, 0x00, 0x00, 0x00, 0x00, 0x00, 0x00, 0x00,
	0x00, 0x00, 0x00, 0x00, 0x00, 0x00, 0x00, 0x00,
	0x00, 0x00, 0x00, 0x00, 0x00, 0x00, 0x00, 0x00,
	0x00, 0x00, 0x00, 0x00, 0x00, 0x00, 0x00, 0x00,
	0x00, 0x00, 0x00, 0x00, 0x00, 0x00, 0x00, 0x00,
	0x00, 0x00, 0x00, 0x00, 0x00, 0x00, 0x00, 0x00,
	0x00, 0x00, 0x00, 0x00, 0x00, 0x00, 0x00, 0x00,
	0x00, 0x00, 0x00, 0x00, 0x00, 0x00, 0x00, 0x00,
	0x00, 0x00, 0x00, 0x00, 0x00, 0x00, 0x00, 0x00,
	0x00, 0x00, 0x00, 0x00, 0x00, 0x00, 0x00, 0x00,
	0x00, 0x00, 0x00, 0x00, 0x00, 0x00, 0x00, 0x00,
	0x00, 0x00, 0x00, 0x00, 0x00, 0x00, 0x00, 0x00,
	0x00, 0x00, 0x00, 0x00, 0x00, 0x00, 0x00, 0x00,
	0x00, 0x00, 0x00, 0x00, 0x00, 0x00, 0x00, 0x00,
	0x00, 0x00, 0x00, 0x00, 0x00, 0x00, 0x00, 0x00,
	0x00, 0x00, 0x00, 0x00, 0x00, 0x00, 0x00, 0x00,
	0x00, 0x00, 0x00, 0x00, 0x00, 0x00, 0x00, 0x00,
	0x00, 0x00, 0x00, 0x00, 0x00, 0x00, 0x00, 0x00,
	0x00, 0x00, 0x00, 0x00, 0x00, 0x00, 0x00, 0x00,
	0x00, 0x00, 0x00, 0x00, 0x00, 0x00, 0x00, 0x00,
	0x00, 0x00, 0x00, 0x00, 0x00, 0x00, 0x00, 0x00,
	0x00, 0x00, 0x00, 0x00, 0x00, 0x00, 0x00, 0x00,
	0x00, 0x00, 0x00, 0x00, 0x00, 0x00, 0x00, 0x00,
	0x00, 0x00, 0x00, 0x00, 0x00, 0x00, 0x00, 0x00,
	0x00, 0x00, 0x00, 0x00, 0x00, 0x00, 0x00, 0x00,
	0x00, 0x00, 0x00, 0x00, 0x00, 0x00, 0x00, 0x00,
	0x00, 0x00, 0x00, 0x00, 0x00, 0x00, 0x00, 0x00,
	0x00, 0x00, 0x00, 0x00, 0x00, 0x00, 0x00, 0x00,
	0x00, 0x00, 0x00, 0x00, 0x00, 0x00, 0x00, 0x00,
	0x00, 0x00, 0x00, 0x00, 0x00, 0x00, 0x00, 0x00,
	0x00, 0x00, 0x00, 0x00, 0x00, 0x00, 0x00, 0x00,
	0x00, 0x00, 0x00, 0x00, 0x00, 0x00, 0x00, 0x00,
	0x00, 0x00, 0x00, 0x00, 0x00, 0x00, 0x00, 0x00,
	0x00, 0x00, 0x00, 0x00, 0x00, 0x00, 0x00, 0x00,
	0x00, 0x00, 0x00, 0x00, 0x00, 0x00, 0x00, 0x00,
	0x00, 0x00, 0x00, 0x00, 0x00, 0x00, 0x00, 0x00,
	0x00, 0x00, 0x00, 0x00, 0x00, 0x00, 0x00, 0x00,
	0x00, 0x00, 0x00, 0x00, 0x00, 0x00, 0x00, 0x00,
	0x00, 0x00, 0x00, 0x00, 0x00, 0x00, 0x00, 0x00,
	0x00, 0x00, 0x00, 0x00, 0x00, 0x00, 0x00, 0x00,
	0x00, 0x00, 0x00, 0x00, 0x00, 0x00, 0x00, 0x00,
	0x00, 0x00, 0x00, 0x00, 0x00, 0x00, 0x00, 0x00,
	0x00, 0x00, 0x00, 0x00, 0x00, 0x00, 0x00, 0x00,
	0x00, 0x00, 0x00, 0x00, 0x00, 0x00, 0x00, 0x00,
	0x00, 0x00, 0x00, 0x00, 0x00, 0x00, 0x00, 0x00,
	0x00, 0x00, 0x00, 0x00, 0x00, 0x00, 0x00, 0x00,
	0x00, 0x00, 0x00, 0x00, 0x00, 0x00, 0x00, 0x00,
	0x00, 0x00, 0x00, 0x00, 0x00, 0x00, 0x00, 0x00,
	0x00, 0x00, 0x00, 0x00, 0x00, 0x00, 0x00, 0x00,
	0x00, 0x00, 0x00, 0x00, 0x00, 0x00, 0x00, 0x00,
	0x00, 0x00, 0x00, 0x00, 0x00, 0x00, 0x00, 0x00,
	0x00, 0x00, 0x00, 0x00, 0x00, 0x00, 0x00, 0x00,
	0x00, 0x00, 0x00, 0x00, 0x00, 0x00, 0x00, 0x00,
	0x00, 0x00, 0x00, 0x00, 0x00, 0x00, 0x00, 0x00,
	0x00, 0x00, 0x00, 0x00, 0x00, 0x00, 0x00, 0x00,
};
```

## src/testkeys.c
```c
/*
 * Copyright (c) 2022 Laczen
 *
 * Keys definition: the bootloader has two types of keys:
 * a. A private encryption key that is used to derive the encryption key
 * b. A set of root public keys that is used to validate images
 *
 * SPDX-License-Identifier: Apache-2.0
 */

#include <stdint.h>

const uint8_t ec256_boot_pri_key[] = {
	0xf6, 0x96, 0xe9, 0x4f, 0xa5, 0x5d, 0xd1, 0xda,
	0x2b, 0x77, 0x44, 0x8d, 0x5b, 0x0a, 0x25, 0x3d,
	0x6b, 0x12, 0x59, 0xe9, 0x7f, 0x9f, 0x75, 0x18,
	0x9c, 0xa3, 0xbd, 0x2c, 0x3a, 0x17, 0x5d, 0x83,
};

const uint32_t ec256_boot_pri_key_len = 32;

const uint8_t ec256_root_pub_key[] = {
	/* This is a good key and test_signature
	 * but bad for test_image */
	0xac, 0x4b, 0xea, 0x21, 0xbf, 0xb6, 0x2f, 0xfc,
	0x1b, 0x89, 0xb6, 0xd5, 0x98, 0x67, 0xcd, 0x56,
	0x78, 0x28, 0x22, 0x55, 0xff, 0x39, 0xc2, 0xbb,
	0x93, 0xf8, 0xd1, 0x0b, 0x19, 0xf0, 0x81, 0x88,
	0x72, 0x82, 0x94, 0x22, 0xff, 0x66, 0x67, 0xa7,
	0xf3, 0xe9, 0x28, 0x60, 0x54, 0x96, 0x66, 0xa1,
	0xea, 0xb8, 0xb2, 0x9e, 0x5c, 0x66, 0xc4, 0x02,
	0x90, 0xd9, 0x95, 0xad, 0x97, 0x77, 0x02, 0x2f,
	/* This is a good key for test_image
	 * but bad for test signature */
	0x2e, 0x8d, 0xef, 0xb8, 0x12, 0xf7, 0x2d, 0x71,
	0x2f, 0xdf, 0xc5, 0xa5, 0x2c, 0x08, 0x5d, 0xc8,
	0xd5, 0x7d, 0x8f, 0x5b, 0xa9, 0xa4, 0x93, 0xf3,
	0xe7, 0x9e, 0x37, 0x98, 0xef, 0xf8, 0xbd, 0x41,
	0x37, 0x94, 0x32, 0x79, 0xea, 0x3b, 0xdc, 0xd4,
	0x9a, 0xc9, 0xb0, 0x98, 0x06, 0x33, 0xee, 0x83,
	0xfd, 0x24, 0x81, 0xfe, 0x09, 0xfa, 0xd3, 0xde,
	0xda, 0xc0, 0x13, 0xd0, 0xad, 0x2b, 0x15, 0x1d,
};

const uint32_t ec256_root_pub_key_len = 128;
```

## src/testvars.c
```c
/*
 * Copyright (c) 2022 Laczen: Set of keys to test signing and encryption
 * key exchange.
 *
 * Keys definition: the bootloader has two types of keys:
 * a. A private encryption key that is used to derive the encryption key
 * b. A set of root public keys that is used to validate images
 *
 * SPDX-License-Identifier: Apache-2.0
 */

#include <stdint.h>

uint8_t test_msg[] = {
	0xff, 0xfe, 0xfd, 0xfc, 0xfb, 0xfa, 0xf9, 0xf8,
	0xf7, 0xf6, 0xf5, 0xf4, 0xf3, 0xf2, 0xf1, 0xf0,
	0xff, 0xfe, 0xfd, 0xfc, 0xfb, 0xfa, 0xf9, 0xf8,
	0xf7, 0xf6, 0xf5, 0xf4, 0xf3, 0xf2, 0xf1, 0xf0
};
uint8_t test_msg_bytes = sizeof(test_msg);

uint8_t test_msg_digest[] = {
	87, 43, 26, 198, 187, 148, 71, 79,
	220, 38, 223, 89, 4, 118, 115, 109,
	231, 185, 12, 231, 123, 212, 221, 103,
	117, 243, 241, 37, 134, 175, 136, 251
};
uint8_t test_msg_digest_bytes = sizeof(test_msg_digest);

uint8_t test_signature[] = {
	252, 86, 17, 53, 85, 142, 204, 211,
	55, 184, 117, 91, 159, 134, 6, 189,
	152, 48, 212, 168, 153, 194, 37, 69,
	159, 214, 44, 58, 39, 64, 19, 36,
	175, 12, 24, 179, 83, 243, 204, 68,
	125, 110, 101, 58, 175, 226, 88, 44,
	44, 100, 215, 166, 176, 109, 107, 238,
	238, 129, 253, 12, 66, 182, 43, 27
};
uint8_t test_signature_bytes = sizeof(test_signature);

uint8_t test_enc_pubkey[] = {
	162, 232, 188, 223, 146, 244, 15, 182,
	171, 144, 101, 158, 237, 57, 205, 66,
	164, 144, 209, 239, 44, 138, 85, 163,
	97, 222, 197, 80, 96, 83, 34, 117,
	201, 36, 44, 25, 158, 7, 5, 165,
	73, 27, 116, 124, 239, 11, 239, 8,
	54, 48, 235, 178, 121, 206, 207, 21,
	192, 36, 184, 152, 219, 62, 106, 175
};
uint8_t test_enc_pubkey_bytes = sizeof(test_enc_pubkey);

uint8_t test_enc_key[] = {
	100, 94, 130, 145, 92, 49, 78, 162,
	75, 150, 19, 98, 20, 112, 197, 170
};
uint8_t test_enc_key_bytes = sizeof(test_enc_key);
```
